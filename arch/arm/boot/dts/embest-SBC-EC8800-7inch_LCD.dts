/*
 * Copyright (C) 2015 Embest Technology Co., Ltd., - http://www.embest-tech.com
 *
 * This program is free software; you can redistribute it and/or modify
 * it under the terms of the GNU General Public License version 2 as
 * published by the Free Software Foundation.
 *
 * This dts is for embest own product:
 * SBC-EC8800
 */
/*/dts-v1/;*/

#include "embest-SBC-EC8800.dts"

&backlight {
	compatible = "pwm-backlight";

	pwms = <&ecap0 0 50000 0>;
	brightness-levels = <0 1 60 90 120 150 180 210 255>;
	default-brightness-level = <6>;
};

&lcd0{
	backlight = <&backlight>;
	backlight_gpio = <7>;
	panel-timing {
		/*This is the timing for 7inch_LCD*/
		clock-frequency = <36000000>;
		hactive = <800>;
		vactive = <480>;
		hfront-porch = <1>;
		hback-porch = <1>;
		hsync-len = <48>;
		vfront-porch = <12>;
		vback-porch = <25>;
		vsync-len = <5>;
		hsync-active = <0>;
		vsync-active = <0>;
		de-active = <1>;
		pixelclk-active = <1>;
	};
};
