## drivers/i2c/chips/Kconfig
```kconfig
#
# Miscellaneous I2C chip drivers configuration
#
# *** DEPRECATED! Do not add new entries! See Makefile ***
#

#menu "Miscellaneous I2C Chip support"


config HDMI_VGA_CH7033
        tristate "HDMI VGA CH7033 CHIP"
        depends on I2C
        help
         say yes to support VGA CH7033 CHIP.
	 
config VGA_CH7026
        tristate "VGA CH7026 CHIP"
        depends on I2C
        help
         say yes to support VGA CH7026 CHIP.

#endmenu
```
